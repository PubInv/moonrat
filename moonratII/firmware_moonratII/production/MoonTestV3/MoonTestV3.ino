//Wokwi version: V10 (https://wokwi.com/projects/390933163302682625)

// LIBRARIES
#include <Wire.h>
#include <Adafruit_GFX.h>
#include <Adafruit_SSD1306.h>
#include <Fuzzy.h>

//OLED VARIABLES
#define SCREEN_WIDTH 128
#define SCREEN_HEIGHT 64
#define OLED_RESET -1
Adafruit_SSD1306 display(SCREEN_WIDTH, SCREEN_HEIGHT, &Wire, OLED_RESET);

// Fuzzy
Fuzzy *fuzzy = new Fuzzy();

// I/0 VARIABLES
const int sensorPin = A0;
int HEATER_PWM = 10;
int buzzerPin = 9;
#define BUTTON_SELECT 5
#define BUTTON_UP 7
#define BUTTON_DOWN 6
float CurrentTemp;
float OldErrorInput = 0.0;

// MENU VARIABLES
int selectedOption = 0;
int tempMaxOptions[] = {29, 35, 37, 41.5};
int tempMax = 0;
int totalOptions = 4; // Change this to the total number of options in the menu

// KALMAN FILTER VARIABLES
float Q = 1E-9;       // Process variance
float R = 1.12E-5;     // Reading variance
float Pc = 0.0;
float G = 0.0;
float P = 1.0;
float Xp = 0.0;
float Zp = 0.0;
float FilteredTemp = 0.0;

// TIMER VARIABLES
unsigned long timeNow = 0;
unsigned long timeLast = 0;
int seconds = 0;
int secondOld = 0;
int minutes = 0;
int hours = 0;

static const unsigned char PROGMEM image_data_Saraarray[] = {
    0xff, 0xff, 0xff, 0xff, 0xff, 0xff, 0xff, 0xff, 0xff, 0xff, 0xff, 0xff, 0xff, 0xff, 0xff, 0xff, 
0xff, 0xff, 0xff, 0xff, 0xff, 0xff, 0xff, 0xff, 0xff, 0xff, 0xff, 0xff, 0xff, 0xff, 0xff, 0xff, 
0xff, 0xff, 0xff, 0xff, 0xff, 0xff, 0xff, 0xff, 0xff, 0xff, 0xff, 0xff, 0xff, 0xff, 0xff, 0xff, 
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0xff, 0xff, 0xff, 0xff, 0xff, 0xff, 0xff, 0xff, 0xff, 0xff, 0xff, 0xff, 0xff, 0xff, 0xff, 0xff
};

void setup() {
  pinMode(buzzerPin, OUTPUT);
  analogWrite(buzzerPin, 50);
  delay(500);
  analogWrite(buzzerPin,0);
  delay(100);
  //Serial.begin(9600);
  if (!display.begin(SSD1306_SWITCHCAPVCC, 0x3C)) {
    //Serial.println(F("Error while initializing OLED"));
    for (;;)
      ;
  }
  delay(100);
  display.clearDisplay();
  display.setTextSize(1);
  display.setTextColor(WHITE);
  display.setCursor(0, 0);
  // Display static text
  display.drawBitmap(0, 0, image_data_Saraarray, 128, 64, 1);
  display.display();
  delay(1500);
  display.clearDisplay();
  display.setCursor(10, 10);
  display.println(F("Version/Wokwi: V13"));
  display.display();
  delay(2500);
  display.clearDisplay();
  pinMode(BUTTON_SELECT, INPUT_PULLUP);
  pinMode(BUTTON_UP, INPUT_PULLUP);
  pinMode(BUTTON_DOWN, INPUT_PULLUP);

  // FuzzyInput (Error)
  FuzzyInput *Error = new FuzzyInput(1);
  FuzzySet *negative = new FuzzySet(-20, -20, -3,0);
  Error->addFuzzySet(negative);
  FuzzySet *zero = new FuzzySet(-0.3, 0, 0, 0.3);
  Error->addFuzzySet(zero);
  FuzzySet *positive = new FuzzySet(0, 3, 20, 20);
  Error->addFuzzySet(positive);
  fuzzy->addFuzzyInput(Error);

   // FuzzyOutput (Frequency)
  FuzzyOutput *Frequency = new FuzzyOutput(1);
  //FuzzySet *fast = new FuzzySet(50, 100, 255, 255);
  FuzzySet *fast = new FuzzySet(255, 255, 200, 20);
  Frequency->addFuzzySet(fast);
  FuzzySet *average = new FuzzySet(50, 10, 10, 0);
  Frequency->addFuzzySet(average);
  FuzzySet *slow = new FuzzySet(0, 1, 1, 5);
  Frequency->addFuzzySet(slow);
  fuzzy->addFuzzyOutput(Frequency);

    // Building Fuzzy Rules
  FuzzyRuleAntecedent *ifErrorNegative = new FuzzyRuleAntecedent();
  ifErrorNegative->joinSingle(negative);
  FuzzyRuleConsequent *thenpwmfast = new FuzzyRuleConsequent();
  thenpwmfast->addOutput(fast);
  FuzzyRule *fuzzyRule01 = new FuzzyRule(1, ifErrorNegative, thenpwmfast);
  fuzzy->addFuzzyRule(fuzzyRule01);


  FuzzyRuleAntecedent *ifErrorZero = new FuzzyRuleAntecedent();
  ifErrorZero->joinSingle(zero);
  FuzzyRuleConsequent *thenpwmAverage = new FuzzyRuleConsequent();
  thenpwmAverage->addOutput(average);
  FuzzyRule *fuzzyRule02 = new FuzzyRule(2, ifErrorZero, thenpwmAverage);
  fuzzy->addFuzzyRule(fuzzyRule02);


  FuzzyRuleAntecedent *ifErrorPositive = new FuzzyRuleAntecedent();
  ifErrorPositive->joinSingle(positive);
  FuzzyRuleConsequent *thenpwmslow = new FuzzyRuleConsequent();
  thenpwmslow->addOutput(slow);
  FuzzyRule *fuzzyRule03 = new FuzzyRule(3, ifErrorPositive, thenpwmslow);
  fuzzy->addFuzzyRule(fuzzyRule03);
}

void loop() {
  displayMenu();
  checkButtons();
  setMaxTemp();
  timeLast = millis()/1000;
  while (true)
  {
    timeNow = millis()/1000; // the number of milliseconds that have passed since boot
    seconds = timeNow - timeLast;

    if(seconds - secondOld != 0)
    {
      int Volt = analogRead(sensorPin);
      CurrentTemp = (Volt * (500.0/ 1023.0)) -50.0; //T6G Sensor
      // Kalman Filter
      Pc = P + Q;
      G = Pc/(Pc + R);
      P = (1-G) * Pc;
      Xp = FilteredTemp;
      Zp = Xp;
      FilteredTemp = G*(CurrentTemp-Zp)+Xp;
      // get entrances
      float ErrorInput = FilteredTemp-tempMax;
      fuzzy->setInput(1, ErrorInput);
      fuzzy->fuzzify();
      float OutputFreq = fuzzy->defuzzify(1);
      analogWrite(HEATER_PWM, round(OutputFreq));  


      display.clearDisplay();
      display.setTextSize(1);
      display.setTextColor(SSD1306_WHITE);
      display.setCursor(2, 2);
      display.print("Temp:");
      display.print(FilteredTemp);
      display.println("C ");
      display.setTextSize(1);
      display.setTextColor(SSD1306_WHITE);
      display.setCursor(2, 15); // Position adjustment for Max legend
      display.print("Max:");
      display.print(tempMax);
      display.print("C");
      display.setCursor(2, 28);
      display.print("Timer:");
      display.print(hours);
      display.print(":");
      display.print(minutes);
      display.print(":");
      display.print(seconds);
      display.setCursor(2, 41);
      display.print("PWM:");
      display.print(round(OutputFreq));
      display.setCursor(2, 54);
      display.print("Error:");
      display.print(ErrorInput);
      display.display();
  }
  if (seconds == 60)
{
  timeLast = timeNow;
  minutes = minutes + 1; 
}
if (minutes == 60)
{
  minutes = 0;
  hours = hours + 1; 
}
secondOld = seconds;
}
  displayMenu();
}

void displayMenu() {
  display.clearDisplay();
  display.setTextSize(1);
  display.setTextColor(SSD1306_WHITE);
  display.setCursor(0, 0);
  display.println(F("SELECT SAMPLE"));
  display.setCursor(10, 12);
  display.println(F("Yeast and mold"));
  display.setCursor(10, 24);
  display.println(F("Coliform"));
  display.setCursor(10, 36);
  display.println(F("Env. listeria"));
  display.setCursor(10, 48);
  display.println(F("Salmonella Express"));
  

  int circleY = 15 + selectedOption * 12; // Position of filled circle
  display.fillCircle(5, circleY, 3, SSD1306_WHITE);
    display.display();
}

void checkButtons() {
  while (tempMax == 0){
  if (digitalRead(BUTTON_SELECT) == HIGH) {
    tempMax = tempMaxOptions[selectedOption];
    delay(200); // Debouncing
  }

  if (digitalRead(BUTTON_UP) == HIGH) {
    selectedOption = (selectedOption - 1 + totalOptions) % totalOptions;
    delay(200); // Debouncing
    displayMenu();
  }

  if (digitalRead(BUTTON_DOWN) == HIGH) {
    selectedOption = (selectedOption + 1) % totalOptions;
    delay(200); // Debouncing
    displayMenu();
  }
  }
}

void setMaxTemp() {
  display.clearDisplay();
  display.setTextSize(1);
  display.setTextColor(SSD1306_WHITE);
  display.setCursor(0, 0);
  display.print("Target Temp.");
  display.setCursor(0, 16);
  display.print(tempMax);
  display.println("C");
  display.display();
  delay(1000);
}