//Wokwi version: V10 (https://wokwi.com/projects/390933163302682625)

#include <Wire.h>
#include <Adafruit_GFX.h>
#include <Adafruit_SSD1306.h>
// #include <Fuzzy.h>
#include <Arduino.h>
#include <PID_v1.h>

#define SCREEN_WIDTH 128
#define SCREEN_HEIGHT 64

#define OLED_RESET -1
Adafruit_SSD1306 display(SCREEN_WIDTH, SCREEN_HEIGHT, &Wire, OLED_RESET);

const int SENSOR_PIN = A0;
int HEATER_PWM = 10;
int BUZZER_PIN = 9;
int TRIGGER_PIN = 11;
int DEBUG_TEMP = 1;
float temperaturaActual;

#define BAUD_RATE 115200
const char* VERSION  = "0.1.1";
const char* PROG_NAME = "Moonrat";

const int numPoints = 60;
float temperaturaHistorial[numPoints] = {0};
const int barWidth = SCREEN_WIDTH / numPoints;

#define BUTTON_SELECT 5
#define BUTTON_UP 7
#define BUTTON_DOWN 6

int selectedOption = 0;
int tempMaxOptions[] = {23, 35, 37, 41};
int timeMaxOptions[] = {12, 24, 36, 48};
int tempMin = 0;
int tempMax = 0;
int timeMin = 0;
int timeMax = 0;
int totalOptions = 4; // Change this to the total number of options in the menu

// I don't know why, but this seems to trip over a compiler bug!
// int heaterDutyCyclePWM = 0;


// TIMER VARIABLES
unsigned long timeNow = 0;
// unsigned long timeLast = 0;
int startingHour = 0;
int seconds = 0;
int secondsSinceTempUpdate = 0;
int minutes = 0;
int hours = startingHour;

int secondsLastDisplay = 0;

int secondsToUpdateTemp = 2;
int secondsToUpdateDisplay = 10; 


static const unsigned char PROGMEM image_data_Saraarray[] = {
    0xff, 0xff, 0xff, 0xff, 0xff, 0xff, 0xff, 0xff, 0xff, 0xff, 0xff, 0xff, 0xff, 0xff, 0xff, 0xff, 
0xff, 0xff, 0xff, 0xff, 0xff, 0xff, 0xff, 0xff, 0xff, 0xff, 0xff, 0xff, 0xff, 0xff, 0xff, 0xff, 
0xff, 0xff, 0xff, 0xff, 0xff, 0xff, 0xff, 0xff, 0xff, 0xff, 0xff, 0xff, 0xff, 0xff, 0xff, 0xff, 
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0xff, 0xff, 0xff, 0xff, 0xff, 0xff, 0xff, 0xff, 0xff, 0xff, 0xff, 0xff, 0xff, 0xff, 0xff, 0xff
};

void splashLCD(Adafruit_SSD1306 &display) {
  display.clearDisplay();
  display.setTextSize(1);
  display.setTextColor(WHITE);
  display.setCursor(0, 0);
  // Display static text
  display.drawBitmap(0, 0, image_data_Saraarray, 128, 64, 1);
  display.display();
}

void splashVersionLCD(Adafruit_SSD1306 &display) {
  display.clearDisplay();
  display.setCursor(0, 10);
  display.println(F("Program:"));
  display.println(PROG_NAME);
  display.println(F("Version:"));
  display.println(VERSION);
  display.display();
}
// void displayAndConfigure() {
//   displayMenu();
//   checkButtons();
//   configurarTemperaturaMaxima();
// }


float readTempAndUpdateFiler() {
  // These are toggled to allow an oscilloscope trigger if you want to look at this.
      digitalWrite(TRIGGER_PIN,HIGH);
      digitalWrite(TRIGGER_PIN,LOW);
      int reading0 = analogRead(SENSOR_PIN); 
      delay(90);
      int reading1 = analogRead(SENSOR_PIN);
//      Serial.print("reading0: "); Serial.println(reading0);
//      Serial.print("reading1: "); Serial.println(reading1);
      int reading = reading1;
      Serial.println();
      Serial.print("reading: "); Serial.println(reading);
      float temperatureC;
      float temperature;
      if (DEBUG_TEMP) {
         //getting the voltage reading from the temperature sensor
 
        // converting that reading to voltage, for 3.3v arduino use 3.3
        float voltage = reading1 * 5.0;
        voltage /= 1024.0; 
        // This is the TMP36 formula
        temperatureC = (voltage - 0.5) * 100 ;  //converting from 10 mv per degree wit 500 mV offset
                                               //to degrees ((voltage - 500mV) times 100)
        Serial.print(temperatureC); Serial.println(" degrees C");
        temperature = temperatureC;
//        Serial.println(CurrentTemp); 
      }
      return temperature;
}


void displayTempMenu() {
  display.clearDisplay();
  display.setTextSize(1);
  display.setTextColor(SSD1306_WHITE);
  display.setCursor(0, 0);
  display.println(F("SELECT SAMPLE"));
  display.setCursor(10, 12);
  display.println(F("23C (Yeast & mold)"));
  display.setCursor(10, 24);
  display.println(F("35C (Coliform)"));
  display.setCursor(10, 36);
  display.println(F("37C (Env. listeria)"));
  display.setCursor(10, 48);
  display.println(F("41C (Salmonella Expr.)"));
  

  int circleY = 15 + selectedOption * 12; // Posición del círculo relleno
  display.fillCircle(5, circleY, 3, SSD1306_WHITE);
    display.display();
}

void checkTimeButtons() {
  while (timeMax == 0){
  if (digitalRead(BUTTON_SELECT) == HIGH) {
    Serial.println(F("BUTTON SELECT PUSHED!"));
    timeMax = int(timeMaxOptions[selectedOption]);
    delay(200); // Debouncing
  }

  if (digitalRead(BUTTON_UP) == HIGH) {
    Serial.println(F("BUTTON UP PUSHED!"));
    selectedOption = (selectedOption - 1 + totalOptions) % totalOptions;
    delay(200); // Debouncing
    displayTimeMenu();
  }

  if (digitalRead(BUTTON_DOWN) == HIGH) {
    Serial.println(F("BUTTON DOWN PUSHED!"));
    selectedOption = (selectedOption + 1) % totalOptions;
    delay(200); // Debouncing
    displayTimeMenu();
  }
  }
}

void displayTimeMenu() {
  display.clearDisplay();
  display.setTextSize(1);
  display.setTextColor(SSD1306_WHITE);
  display.setCursor(0, 0);
  display.println(F("SELECT INC TIME:"));
  display.setCursor(10, 12);
  display.println(F("12 HR"));
  display.setCursor(10, 24);
  display.println(F("24 HR"));
  display.setCursor(10, 36);
  display.println(F("36 HR"));
  display.setCursor(10, 48);
  display.println(F("48 HR"));
  
  int circleY = 15 + selectedOption * 12; // Position of filled circle
  display.fillCircle(5, circleY, 3, SSD1306_WHITE);
  display.display();
}

void checkTempButtons() {
  while (tempMax == 0){
  if (digitalRead(BUTTON_SELECT) == HIGH) {
    Serial.println(F("BUTTON SELECT PUSHED!"));
    tempMax = tempMaxOptions[selectedOption];
    delay(200); // Debouncing
  }

  if (digitalRead(BUTTON_UP) == HIGH) {
    Serial.println(F("BUTTON UP PUSHED!"));
    selectedOption = (selectedOption - 1 + totalOptions) % totalOptions;
    delay(200); // Debouncing
    displayTempMenu();
  }

  if (digitalRead(BUTTON_DOWN) == HIGH) {
    Serial.println(F("BUTTON DOWN PUSHED!"));
    selectedOption = (selectedOption + 1) % totalOptions;
    delay(200); // Debouncing
    displayTempMenu();
  }
  }
}
void displayExitScreen() {
  display.clearDisplay();
  display.setTextSize(1);
  display.setTextColor(SSD1306_WHITE);
  display.setCursor(10, 8);
  display.println(F("INCUBTATION TIME"));
  display.setCursor(30, 17);
  display.println(F("COMPLETED!"));
  display.setCursor(18, 30);
  display.println(F("TO EXIT, PRESS"));
  display.setCursor(38, 39);
  display.println(F("UP/DOWN"));
  display.setCursor(18, 48);
  display.println(F("SIMULTANEOUSLY"));
  display.display();

}
void configurarTemperaturaMaxima() {
  display.clearDisplay();
  display.setTextSize(1);
  display.setTextColor(SSD1306_WHITE);
  display.setCursor(0, 0);
  display.print("Target Temp.");
  display.setCursor(0, 16);
  display.print(tempMax);
  display.println("C");
  display.display();
  delay(1000);
}
void setMaxTemp() {
  display.clearDisplay();
  display.setTextSize(1);
  display.setTextColor(SSD1306_WHITE);
  display.setCursor(0, 0);
  display.print("Target Temp.");
  display.setCursor(0, 16);
  display.print(tempMax);
  display.println("C");
  display.setCursor(0, 32);
  display.print("Inc Time");
  display.setCursor(0, 48);
  display.print(timeMax);
  display.println("H");
  display.display();
  delay(2000);
}

void menuSelections() {
  tempMax = 0;
  timeMax = 0;
  displayTempMenu();
  checkTempButtons();
  selectedOption = 0;
  displayTimeMenu();
  checkTimeButtons();
  setMaxTemp();
}
void updateDisplay() {
  display.clearDisplay();
  display.setTextSize(1);
  display.setTextColor(SSD1306_WHITE);
  display.setCursor(0, 0);
  display.print("Temp: ");
  display.print(temperaturaActual);
  display.println(" C");
    
// Mostrar la gráfica de temperatura en el resto de la pantalla
  for (int i = 0; i < numPoints; i++) {
    int x = i * barWidth;
    int barHeight = map(temperaturaHistorial[i], 0, 45, 0, 50);
    display.fillRect(x, SCREEN_HEIGHT - barHeight, barWidth, barHeight-14, SSD1306_WHITE);
    //display.fillRect(x, 32 , 1, 6, SSD1306_WHITE);
  }

  // Mostrar las líneas horizontales para las temperaturas máxima y mínima
  int yMax = map(tempMax, 0, 45, 0, 14);
  int yMin = map(tempMin, 0, 45, 50, 0);
  display.drawFastHLine(0, yMax, SCREEN_WIDTH, SSD1306_WHITE);
  display.drawFastHLine(0, yMin, SCREEN_WIDTH, SSD1306_WHITE);

  // Mostrar la etiqueta de temperatura máxima y mínima
  display.setTextSize(1);
  display.setTextColor(SSD1306_WHITE);
  display.setCursor(80, 2); // Ajuste de posición para la leyenda Max
  display.print("Max: ");
  display.print(tempMax);
  display.print("C");
  display.setCursor(80, SCREEN_HEIGHT-8); // Ajuste de posición para la leyenda Min
  display.print("Min: ");
  display.print(tempMin);
  display.print("C");
  display.display();
}
void setup() {
  pinMode(BUZZER_PIN, OUTPUT);
  analogWrite(BUZZER_PIN, 50);
  delay(500);
  analogWrite(BUZZER_PIN,0);
  delay(100);
  Serial.begin(BAUD_RATE);
  delay(1000);
  while (!display.begin(SSD1306_SWITCHCAPVCC, 0x3C)) {
      Serial.println(F("Error al iniciar el OLED"));;
  }
  delay(100);
  splashLCD(display);
  delay(1500);
  splashVersionLCD(display);
  delay(2500);
  display.clearDisplay();
  pinMode(BUTTON_SELECT, INPUT_PULLUP);
  pinMode(BUTTON_UP, INPUT_PULLUP);
  pinMode(BUTTON_DOWN, INPUT_PULLUP);

  menuSelections();
}
void loop() {
  int flag = 0;
  int heaterDutyCyclePWM = 0;
  while ((digitalRead(BUTTON_UP) == HIGH) || (digitalRead(BUTTON_DOWN) == HIGH) || (digitalRead(BUTTON_SELECT) == HIGH))
      {
        flag = 1;
      } 
   
  if (flag) {
    delay(100);
    menuSelections();
    return;
  }
  temperaturaActual = readTempAndUpdateFiler();

  for (int i = 0; i < numPoints - 1; i++)
  {
    temperaturaHistorial[i] = temperaturaHistorial[i + 1];
  }

  temperaturaHistorial[numPoints - 1] = temperaturaActual;
  updateDisplay();

  const int DISABLE_HEATER = false;
  heaterDutyCyclePWM = (temperaturaActual > tempMax) ?  255 : 0;
  // if (DISABLE_HEATER) heaterDutyCyclePWM = 0;
//   if (temperaturaActual > tempMax) {
//     heaterDutyCyclePWM = 255;
//  //   analogWrite(HEATER_PWM, heaterDutyCyclePWM);
//   } else {
//     heaterDutyCyclePWM = 0;
//   //  analogWrite(HEATER_PWM, heaterDutyCyclePWM);
//   }
  if (DISABLE_HEATER) {
    heaterDutyCyclePWM = 0;
  }
  analogWrite(HEATER_PWM, heaterDutyCyclePWM);
  delay(1000);
//  displayMenu();
}